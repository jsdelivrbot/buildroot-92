## configs/raspberrypi0_packetTest1_defconfig
```kconfig
BR2_arm=y
BR2_arm1176jzf_s=y
BR2_ARM_EABIHF=y

# Linux headers same as kernel, a 4.4 series
BR2_PACKAGE_HOST_LINUX_HEADERS_CUSTOM_4_4=y

BR2_TOOLCHAIN_BUILDROOT_CXX=y

# WCHAR-support required for OMXPLAYER
BR2_TOOLCHAIN_BUILDROOT_WCHAR=y
BR2_USE_WCHAR=y

BR2_LINUX_KERNEL=y
BR2_LINUX_KERNEL_CUSTOM_GIT=y
BR2_LINUX_KERNEL_CUSTOM_REPO_URL="https://github.com/raspberrypi/linux.git"
BR2_LINUX_KERNEL_CUSTOM_REPO_VERSION="26f3b72a9c049be10e6af196252283e1f6ab9d1f"
BR2_LINUX_KERNEL_DEFCONFIG="bcmrpi"

# Build the DTBs for A/B from the kernel sources: the zero is the same
# as the A+ model, just in a different form-factor
BR2_LINUX_KERNEL_DTS_SUPPORT=y
BR2_LINUX_KERNEL_INTREE_DTS_NAME="bcm2708-rpi-b-plus"

# Additional packages
BR2_PACKAGE_HTOP=y

# RPI-Userland required for OMXPLAYER
BR2_PACKAGE_RPI_USERLAND=y

# OMXPLAYER required for streaming with livestreamer
BR2_PACKAGE_OMXPLAYER=y

# OpenSSL for Python HTTPS
BR2_PACKAGE_OPENSSL=y
BR2_PACKAGE_OPENSSL_BIN=y
BR2_PACKAGE_OPENSSL_ENGINES=y

# SSL Certificates
BR2_PACKAGE_CA_CERTIFICATES=y

# Python & GIT to install livestreamer on target device
BR2_PACKAGE_PYTHON=y
BR2_PACKAGE_PYTHON_SETUPTOOLS=y
BR2_PACKAGE_ZLIB=y
BR2_PACKAGE_E2FSPROGS=y
BR2_PACKAGE_E2FSPROGS_RESIZE2FS=y
BR2_PACKAGE_GIT=y

# NTP Client
BR2_PACKAGE_NTP=y
BR2_PACKAGE_NTP_NTPD=y
BR2_PACKAGE_NTP_NTPQ=y

BR2_PACKAGE_RPI_FIRMWARE=y
# BR2_PACKAGE_RPI_FIRMWARE_INSTALL_DTB_OVERLAYS is not set

# Required tools to create the SD image
BR2_PACKAGE_HOST_DOSFSTOOLS=y
BR2_PACKAGE_HOST_GENIMAGE=y
BR2_PACKAGE_HOST_MTOOLS=y

# Filesystem / image
BR2_TARGET_ROOTFS_EXT2=y
BR2_TARGET_ROOTFS_EXT2_4=y
# BR2_TARGET_ROOTFS_TAR is not set
BR2_ROOTFS_POST_BUILD_SCRIPT="board/raspberrypi0/post-build.sh"
BR2_ROOTFS_POST_IMAGE_SCRIPT="board/raspberrypi0/post-image.sh"
```
